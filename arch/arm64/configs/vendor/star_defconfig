## arch/arm64/configs/vendor/star_defconfig
```kconfig
# 基础
CONFIG_LOCALVERSION=""
CONFIG_LOCALVERSION_AUTO=n
CONFIG_BUILD_SALT=""
CONFIG_CC_VERSION_TEXT="Clang"

# 架构
CONFIG_ARM64=y
CONFIG_ARM64_PAGE_SHIFT=12
CONFIG_ARM64_CONT_PMD_SHIFT=n
CONFIG_ARCH_DMA_ADDR_T_64BIT=y
CONFIG_NEED_DMA_MAP_STATE=y
CONFIG_FORCE_MAX_ZONEORDER=11
CONFIG_HAVE_ARCH_VMAP_STACK=y
CONFIG_VMAP_STACK=y
CONFIG_COMPAT=y
CONFIG_SYSVIPC_COMPAT=y

# 关键修复：模块版本兼容（解决 disagrees about version）
CONFIG_MODVERSIONS=y
CONFIG_MODULE_SIG=n
CONFIG_MODULE_SIG_ALL=n
CONFIG_MODULE_SIG_FORCE=n
CONFIG_MODULE_COMPRESS=n
CONFIG_UNUSED_SYMBOLS=n

# 关闭调试（解决稳定性差、重启）
CONFIG_DEBUG_KERNEL=n
CONFIG_DEBUG_FS=n
CONFIG_DEBUG_INFO=n
CONFIG_TRACEPOINTS=n
CONFIG_TRACING=n
CONFIG_TRACEPRINTK=n
CONFIG_SCHED_DEBUG=n
CONFIG_LOCK_DEBUGGING_SUPPORT=n
CONFIG_PROVE_LOCKING=n

# 关闭看门狗（解决秒重启）
CONFIG_WATCHDOG=n
CONFIG_QCOM_WATCHDOG=n
CONFIG_QCOM_HYP_WATCHDOG=n

# 关闭 AVB（解决校验失败重启）
CONFIG_AVB=n
CONFIG_AVB_VERITY=n

# 小米11 5.4 GKI 必须打开
CONFIG_QGKI=y
CONFIG_QCOM_CLK_SMMU_BYPASS=y
CONFIG_QCOM_LAZY_MAPPING=y
CONFIG_QCOM_MEMORY_DUMP=y
CONFIG_QCOM_SCM=y
CONFIG_QCOM_SCM_DOWNLOAD=y
CONFIG_QCOM_SYS_APK_LOADER=y

# 文件系统（必须打开，否则VFS无法挂载）
CONFIG_EXT4_FS=y
CONFIG_EXT4_FS_POSIX_ACL=y
CONFIG_EXT4_FS_SECURITY=y
CONFIG_F2FS_FS=y
CONFIG_F2FS_STAT=y
CONFIG_SQUASHFS=y
CONFIG_EROFS_FS=y

# 显示/DRM 修复（解决msm_drm崩溃）
CONFIG_DRM=y
CONFIG_DRM_MSM=y
CONFIG_DRM_MSM_DSI=y
CONFIG_DRM_MSM_DP=n
CONFIG_THERMAL_WATCHDOG=n
CONFIG_MSM_DSI_PANEL=y
CONFIG_MDSS=y
CONFIG_MDSS_DSI=y

# 内核SU + SUSFS（rsuntk最小可用）
CONFIG_KERNELSU=y
CONFIG_KSU_ALLOW_LIST=y
CONFIG_KSU_DENY_LIST=y
CONFIG_KSU_SAFEMODE=y
CONFIG_KSU_GRANT_ROOT=y
CONFIG_SUSFS=y
CONFIG_SUSFS_RW=y
CONFIG_SUSFS_HIDE=y
CONFIG_SUSFS_UMOUNT=y

# 电源/重启修复
CONFIG_PM=y
CONFIG_PM_CLK=y
CONFIG_QCOM_SPM=y
CONFIG_QCOM_RMTFS=y
CONFIG_QCOM_SMP2P=y
CONFIG_QCOM_SMSM=y

# 必须关闭导致冲突的项
CONFIG_QCOM_SMMU_DISABLE_FAULT_HANDLER=y
CONFIG_QCOM_CMA_NO_CONTIG=y
CONFIG_STRICT_KERNEL_RWX=n
CONFIG_STRICT_MODULE_RWX=n
CONFIG_DEBUG_RODATA=n

# 小米11 硬件适配
CONFIG_PINCTRL_LAHAINA=y
CONFIG_PMIC_LAHAINA=y
CONFIG_REGULATOR_LAHAINA=y
CONFIG_SPMI=y
CONFIG_SPMI_MSI=y
CONFIG_EXTCON_QCOM_SPMI_MISC=y
CONFIG_INPUT_TOUCHSCREEN=y
CONFIG_INPUT_TOUCHSCREEN_XIAOMI=y
CONFIG_FINGERPRINT_GOODIX=y

# 网络/IPA（不影响开机）
CONFIG_QCOM_IPA=n
CONFIG_QCOM_IPA_FW=n
CONFIG_QCOM_EMAC=y

# 声音（修复模块加载失败）
CONFIG_SND=n
CONFIG_SND_SOC=n
CONFIG_SND_HRTIMER=n
CONFIG_SND_QCOM_LPASS=n
```
